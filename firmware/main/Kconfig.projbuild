## firmware/main/Kconfig.projbuild
```kconfig
menu "Development Configuration"

config AWS_IOT_ENDPOINT
    string "AWS IoT Endpoint"
    default "mqtt.app.healthesolutions.ca"

config AWS_IOT_THING_NAME
    string "AWS IoT Thing Name"
    default "PillOrganizer_Test_001"

config DEV_CLAIM_TENANT_ID
    string "Claim Tenant ID"
    default "public"
    help
        Tenant ID returned from the claim credential exchange.
        Obtained by running the iot_provision.py script.

config DEV_CLAIM_TOKEN
    string "Claim Token (claimId)"
    default ""
    help
        claimId returned from the claim credential exchange.
        Obtained by running the iot_provision.py script.

config CONTROL_PLANE_URL
    string "Control Plane Base URL"
    default "https://control-plane.app.healthesolutions.ca"
    help
        Base URL for control plane endpoints (device/claim_cert, etc.)
        Used for fetching temporary certificates during Fleet Provisioning.

config RESET_PROVISIONED_ON_BOOT
    bool "Reset WiFi provisioning on boot (for testing)"
    default n
    help
        Erase WiFi provisioning credentials on every boot to test BLE provisioning.
        AWS IoT certificates are preserved. Disable this after testing.

endmenu

menu "Watchdog Configuration"

config ESP_TASK_WDT_TIMEOUT_S
    int "Task Watchdog Timeout (seconds)"
    default 60
    range 1 3600
    help
        The Task Watchdog Timer timeout in seconds. Set to 120 to accommodate
        expensive TLS operations like ECDH key exchange during AWS IoT connections.

endmenu

menu "Firmware Features"

config FIRMWARE_ENGINEERING
    bool "Enable Engineering Features (development only)"
    default n
    help
        Enable engineering web interface with testing and debugging functions.
        Includes: manual reload trigger, reset pending bins for retesting.
        Leave disabled by default; enable explicitly in development/test configs
        (for example via sdkconfig.defaults or CI profiles). Keep disabled in
        production builds to remove all engineering endpoints and handlers.

endmenu

menu "Emulator Configuration"

config EMULATOR_MODE
    bool "Build for QEMU emulator"
    default n
    help
        Build the firmware targeting the ESP32 QEMU emulator. This disables
        hardware peripherals (GPIO, I2C, ULP, battery, BLE provisioning) and
        switches the network stack from Wi-Fi to the OpenCores Ethernet MAC
        driver supported by the QEMU emulator. A UART-based engineering CLI
        is provided in place of BLE provisioning.

config EMULATOR_SERIAL_NUMBER
    string "Emulated device serial number"
    depends on EMULATOR_MODE
    default "emu000000001"
    help
        Fixed serial number to use when running inside the emulator. On real
        hardware the serial number is derived from the MAC address in eFuse.
        This lets multiple emulator instances use distinct identities.

endmenu
```

## firmware/sdkconfig.defaults
```kconfig
# Safe defaults - no secrets
CONFIG_DEV_WIFI_ENABLED=n
CONFIG_AWS_IOT_ENDPOINT="mqtt.healthesolutions.ca"
CONFIG_AWS_IOT_THING_NAME="PillOrganizer_Test_001"

#
# Bluetooth
#
CONFIG_BT_ENABLED=y
# CONFIG_BT_BLUEDROID_ENABLED is not set
CONFIG_BT_NIMBLE_ENABLED=y
# CONFIG_BT_CONTROLLER_ONLY is not set
CONFIG_BT_CONTROLLER_ENABLED=y
# CONFIG_BT_CONTROLLER_DISABLED is not set

#
# NimBLE Options
#
CONFIG_BT_NIMBLE_MEM_ALLOC_MODE_INTERNAL=y
# CONFIG_BT_NIMBLE_MEM_ALLOC_MODE_DEFAULT is not set
# CONFIG_BT_NIMBLE_LOG_LEVEL_NONE is not set
# CONFIG_BT_NIMBLE_LOG_LEVEL_ERROR is not set
# CONFIG_BT_NIMBLE_LOG_LEVEL_WARNING is not set
CONFIG_BT_NIMBLE_LOG_LEVEL_INFO=y
# CONFIG_BT_NIMBLE_LOG_LEVEL_DEBUG is not set
CONFIG_BT_NIMBLE_LOG_LEVEL=1
CONFIG_BT_NIMBLE_MAX_CONNECTIONS=3
CONFIG_BT_NIMBLE_MAX_BONDS=3
CONFIG_BT_NIMBLE_MAX_CCCDS=8
CONFIG_BT_NIMBLE_L2CAP_COC_MAX_NUM=0
CONFIG_BT_NIMBLE_PINNED_TO_CORE_0=y
# CONFIG_BT_NIMBLE_PINNED_TO_CORE_1 is not set
CONFIG_BT_NIMBLE_PINNED_TO_CORE=0
CONFIG_BT_NIMBLE_HOST_TASK_STACK_SIZE=4096
CONFIG_BT_NIMBLE_ROLE_CENTRAL=y
CONFIG_BT_NIMBLE_ROLE_PERIPHERAL=y
CONFIG_BT_NIMBLE_ROLE_BROADCASTER=y
CONFIG_BT_NIMBLE_ROLE_OBSERVER=y
CONFIG_BT_NIMBLE_NVS_PERSIST=y
# CONFIG_BT_NIMBLE_SMP_ID_RESET is not set
CONFIG_BT_NIMBLE_SECURITY_ENABLE=y
CONFIG_BT_NIMBLE_SM_LEGACY=y
CONFIG_BT_NIMBLE_SM_SC=y
# CONFIG_BT_NIMBLE_SM_SC_DEBUG_KEYS is not set
CONFIG_BT_NIMBLE_LL_CFG_FEAT_LE_ENCRYPTION=y
CONFIG_BT_NIMBLE_SM_LVL=0
# CONFIG_BT_NIMBLE_DEBUG is not set
# CONFIG_BT_NIMBLE_DYNAMIC_SERVICE is not set
CONFIG_BT_NIMBLE_SVC_GAP_DEVICE_NAME="nimble"
CONFIG_BT_NIMBLE_GAP_DEVICE_NAME_MAX_LEN=31
CONFIG_BT_NIMBLE_ATT_PREFERRED_MTU=517

#
# WiFi Provisioning
#
CONFIG_WIFI_PROV_SCAN_MAX_ENTRIES=16
CONFIG_WIFI_PROV_AUTOSTOP_TIMEOUT=30
CONFIG_WIFI_PROV_BLE_FORCE_ENCRYPTION=n
CONFIG_BT_NIMBLE_ATT_PREFERRED_MTU=517
CONFIG_BT_NIMBLE_SVC_GAP_APPEARANCE=0
```

## firmware/src/Kconfig.projbuild
```kconfig
menu "Development Configuration"

config DEV_WIFI_ENABLED
    bool "Enable development WiFi (skip BLE provisioning)"
    default y
    help
        Use hardcoded WiFi credentials for development.

config DEV_WIFI_SSID
    string "WiFi SSID"
    depends on DEV_WIFI_ENABLED
    default ""

config DEV_WIFI_PASSWORD
    string "WiFi Password"
    depends on DEV_WIFI_ENABLED
    default ""

config AWS_IOT_ENDPOINT
    string "AWS IoT Endpoint"
    default "mqtt.app.healthesolutions.ca"

config AWS_IOT_THING_NAME
    string "AWS IoT Thing Name"
    default "PillOrganizer_Test_001"

config DEV_CLAIM_TENANT_ID
    string "Claim Tenant ID"
    default "public"
    help
        Tenant ID returned from the claim credential exchange.
        Obtained by running the iot_provision.py script.

config DEV_CLAIM_TOKEN
    string "Claim Token (claimId)"
    default ""
    help
        claimId returned from the claim credential exchange.
        Obtained by running the iot_provision.py script.

config RESET_PROVISIONED_ON_BOOT
    bool "Reset WiFi provisioning on boot (for testing)"
    default n
    help
        Erase WiFi provisioning credentials on every boot to test BLE provisioning.
        AWS IoT certificates are preserved. Disable this after testing.

endmenu

menu "Watchdog Configuration"

config ESP_TASK_WDT_TIMEOUT_S
    int "Task Watchdog Timeout (seconds)"
    default 60
    range 1 3600
    help
        The Task Watchdog Timer timeout in seconds. Set to 120 to accommodate
        expensive TLS operations like ECDH key exchange during AWS IoT connections.

endmenu
```
